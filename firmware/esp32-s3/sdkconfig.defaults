## firmware/esp32-s3/sdkconfig.defaults
```kconfig
CONFIG_FREERTOS_HZ=1000
CONFIG_PARTITION_TABLE_SINGLE_APP_LARGE=y
# CONFIG_AUTOSTART_ARDUINO is not set
CONFIG_ARDUINO_SELECTIVE_COMPILATION=y
# CONFIG_ARDUINO_SELECTIVE_SPI is not set
# CONFIG_ARDUINO_SELECTIVE_Wire is not set
# CONFIG_ARDUINO_SELECTIVE_ESP_SR is not set
# CONFIG_ARDUINO_SELECTIVE_EEPROM is not set
# CONFIG_ARDUINO_SELECTIVE_Preferences is not set
# CONFIG_ARDUINO_SELECTIVE_Ticker is not set
# CONFIG_ARDUINO_SELECTIVE_Update is not set
# CONFIG_ARDUINO_SELECTIVE_Zigbee is not set
# CONFIG_ARDUINO_SELECTIVE_FS is not set
# CONFIG_ARDUINO_SELECTIVE_Network is not set
# CONFIG_ARDUINO_SELECTIVE_Ethernet is not set
# CONFIG_ARDUINO_SELECTIVE_PPP is not set
# CONFIG_ARDUINO_SELECTIVE_Hash is not set
# CONFIG_ARDUINO_SELECTIVE_BLE is not set
# CONFIG_ARDUINO_SELECTIVE_BluetoothSerial is not set
# CONFIG_ARDUINO_SELECTIVE_SimpleBLE is not set
# CONFIG_ARDUINO_SELECTIVE_RainMaker is not set
# CONFIG_ARDUINO_SELECTIVE_OpenThread is not set
# CONFIG_ARDUINO_SELECTIVE_Insights is not set
CONFIG_MICRO_ROS_ESP_XRCE_DDS_MIDDLEWARE=y
CONFIG_MICRO_ROS_ESP_UART_TRANSPORT=y
CONFIG_TINYUSB_CDC_ENABLED=y
CONFIG_TINYUSB_CDC_COUNT=1
CONFIG_TINYUSB_CDC_RX_BUFSIZE=512
CONFIG_TINYUSB_CDC_TX_BUFSIZE=512
CONFIG_TINYUSB_DESC_MANUFACTURER_STRING="Project LAKSA"
CONFIG_TINYUSB_DESC_PRODUCT_STRING="LAKSA micro-ROS CDC"
CONFIG_TINYUSB_DESC_SERIAL_STRING="LAKSA-ESP32S3-001"
CONFIG_TINYUSB_DESC_CDC_STRING="LAKSA micro-ROS transport"
CONFIG_LAKSA_WEB_DASHBOARD=y
CONFIG_LAKSA_ROS_DOMAIN_ID=0
CONFIG_LAKSA_MOTOR_POLE_PAIRS=2
CONFIG_LAKSA_GEAR_REDUCTION_X1000=11820
CONFIG_LAKSA_WHEEL_DIAMETER_MM=109
CONFIG_LAKSA_WHEELBASE_MM=324
CONFIG_LAKSA_MAX_STEERING_ANGLE_MRAD=523
CONFIG_LAKSA_DRIVE_FORWARD_SIGN=1
```
